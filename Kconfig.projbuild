## main/Kconfig.projbuild
```kconfig
menu "Device Configuration"
    config PRODUCT_KEY
        string
        prompt "Product Key"

    config DEVICE_NAME
        string
        prompt "Device Name"

    config DEVICE_SECRET
        string
        prompt "Device Secret"
    endmenu

menu "Version"
    config FIRMWARE_VERSION
        string 
        prompt "Firmware Version"
    endmenu

menu "AliCloud URL"
    config ALICLOUD_URL
        string 
        prompt "Alicould IoT instance Url"
    endmenu
```

## sdkconfig.defaults
```kconfig
CONFIG_IDF_TARGET="esp32s3"

CONFIG_ESPTOOLPY_FLASHSIZE_16MB=y
CONFIG_ESPTOOLPY_FLASHSIZE="16MB"

CONFIG_PARTITION_TABLE_CUSTOM=y

CONFIG_ALICLOUD_URL="iot-06z009wo9u7aniw.mqtt.iothub.aliyuncs.com"

CONFIG_PRODUCT_KEY="ia66OXimz4V"
CONFIG_DEVICE_NAME="nanhai_test_1"
CONFIG_DEVICE_SECRET="1c5cc55678e5bf874b4462cf8a739856"

CONFIG_FIRMWARE_VERSION="0.1.0"
```
